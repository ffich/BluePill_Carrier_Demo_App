/*
 * CHAOS demo tasks
 * Generated by CHAOS Configuration Wizard
 */

/* Includes */
#include "os.h"
#include "os_task.h"
#include "strings.h"
#include "main.h"
#include "ssd1306.h"
#include <stdio.h>
#include <stdint.h>

/* Cfg */
//#define RTC_SET
//#define USB_LOGGING

/* Defines */
#define DS3231_ADDR        			(0x68 << 1)   // HAL wants 8-bit address
#define DS3231_REG_TIME    			0x00          // Seconds register
#define BMP280_ADDR     			(0x76 << 1)
#define TMP102_ADDR_0x48   			(0x48 << 1)  // HAL wants 8-bit address

#define BME280_ADDR_0x76     (0x76 << 1)  // HAL wants 8-bit address
#define BME280_REG_ID        0xD0
#define BME280_REG_RESET     0xE0
#define BME280_REG_STATUS    0xF3
#define BME280_REG_CTRL_H    0xF2
#define BME280_REG_CTRL_M    0xF4
#define BME280_REG_CONFIG    0xF5
#define BME280_REG_DATA      0xF7          // F7..FE: press(3), temp(3), hum(2)

#define TMP102_REG_TEMP    0x00
#define TMP102_REG_CONFIG  0x01
#define TMP102_REG_TLOW    0x02
#define TMP102_REG_THIGH   0x03

#define TMP102_REG_ID      0x0B

#define LIN_FRAME_ID 0x12

/* Types */
typedef struct {
  uint8_t seconds;
  uint8_t minutes;
  uint8_t hours;
  uint8_t dayOfWeek;   // 1..7
  uint8_t day;         // 1..31
  uint8_t month;       // 1..12
  uint16_t year;       // full year e.g. 2026
} DS3231_DateTime;

typedef struct {
  uint16_t dig_T1; int16_t dig_T2; int16_t dig_T3;
  uint16_t dig_P1; int16_t dig_P2; int16_t dig_P3; int16_t dig_P4; int16_t dig_P5;
  int16_t  dig_P6; int16_t dig_P7; int16_t dig_P8; int16_t dig_P9;
  uint8_t  dig_H1; int16_t dig_H2; uint8_t dig_H3; int16_t dig_H4; int16_t dig_H5; int8_t dig_H6;

  int32_t  t_fine;
  I2C_HandleTypeDef *hi2c;
  uint16_t addr; // 8-bit address (shifted)
} BME280_Handle;

typedef struct {
  float temperature_c;
  float pressure_hpa;
  float humidity_rh;
} BME280_Data;

/* Imported globals */
extern CAN_HandleTypeDef hcan;
extern TIM_HandleTypeDef htim2;
extern UART_HandleTypeDef huart1;
extern UART_HandleTypeDef huart2;
extern UART_HandleTypeDef huart3;
extern ADC_HandleTypeDef hadc1;
extern I2C_HandleTypeDef hi2c1;
extern ssd1306_t oled;

/* Globals */
CAN_TxHeaderTypeDef txHeader;
uint32_t txMailbox;
uint8_t txData[8];
uint32_t adc_in1;
DS3231_DateTime now;
DS3231_DateTime set = {
  .seconds 				= 0,
  .minutes 				= 07,
  .hours 				= 19,
  .dayOfWeek 			= 7,
  .day 					= 15,
  .month 				= 2,
  .year 				= 2026
};

BME280_Handle bme = {
  .hi2c = &hi2c1,
  .addr = BME280_ADDR_0x76,
  .t_fine = 0
};

BME280_Data d;

float temp;

/* Local Functions */

static uint8_t bcd2bin(uint8_t v)
{
  return (v & 0x0F) + ((v >> 4) * 10);
}

static uint8_t bin2bcd(uint8_t v)
{
  return (uint8_t)(((v / 10) << 4) | (v % 10));
}

/* Send CAN Message */
void CAN_SendMessage(uint32_t ID, uint8_t DLC, uint8_t * Data)
{
	/* Header */
	txHeader.StdId = ID;          		// ID standard (11 bit)
	txHeader.ExtId = 0;              	// Non usato se IDE = STD
	txHeader.IDE   = CAN_ID_STD;     	// CAN_ID_STD oppure CAN_ID_EXT
	txHeader.RTR   = CAN_RTR_DATA;   	// CAN_RTR_DATA o CAN_RTR_REMOTE
	txHeader.DLC   = DLC;              	// Numero byte (0..8)
	txHeader.TransmitGlobalTime = DISABLE;

	/* Data */
	txData[0] = Data[0];
	txData[1] = Data[1];
	txData[2] = Data[2];
	txData[3] = Data[3];
	txData[4] = Data[4];
	txData[5] = Data[5];
	txData[6] = Data[6];
	txData[7] = Data[7];

	/* Wait for the mailbox to become free */
	while (HAL_CAN_GetTxMailboxesFreeLevel(&hcan) == 0)
	{
		Os_Yield();
	}

	/* Transmit message */
	if (HAL_CAN_AddTxMessage(&hcan, &txHeader, txData, &txMailbox) != HAL_OK)
	{
	    /* Tx Error */
	}
}

/* RS485 */
void RS485_SendString (const char *str)
{
    HAL_UART_Transmit(
        &huart3,
        (uint8_t *)str,
        strlen(str),
        HAL_MAX_DELAY
    );
}

/* Serial */
void SERIAL_SendString (const char *str)
{
    HAL_UART_Transmit(
        &huart1,
        (uint8_t *)str,
        strlen(str),
        HAL_MAX_DELAY
    );
}

/* RTC read */
HAL_StatusTypeDef DS3231_ReadDateTime(I2C_HandleTypeDef *hi2c, DS3231_DateTime *dt)
{
  uint8_t raw[8];

  // Read 7 byte: sec, min, hour, dow, date, month, year - Bug on I2C HAL, last byte duplicated.
  HAL_StatusTypeDef st = HAL_I2C_Mem_Read(
      hi2c,
      DS3231_ADDR,
      DS3231_REG_TIME,
      I2C_MEMADD_SIZE_8BIT,
      raw,
      8,
      100
  );

  if (st != HAL_OK) return st;

  // Seconds: bit7 = CH (clock halt)
  dt->seconds = bcd2bin(raw[0] & 0x7F);
  dt->minutes = bcd2bin(raw[1] & 0x7F);

  // Hours
  if (raw[2] & 0x40) {
    // 12-hour mode
    uint8_t hour12 = bcd2bin(raw[2] & 0x1F);
    uint8_t pm = (raw[2] & 0x20) ? 1 : 0;
    // 24h format conversion
    if (hour12 == 12) dt->hours = pm ? 12 : 0;
    else dt->hours = pm ? (hour12 + 12) : hour12;
  } else {
    // 24-hour mode
    dt->hours = bcd2bin(raw[2] & 0x3F);
  }

  dt->dayOfWeek = bcd2bin(raw[3] & 0x07);
  dt->day       = bcd2bin(raw[4] & 0x3F);

  // Month: bit7 = Century
  dt->month = bcd2bin(raw[5] & 0x1F);

  // Year: 0..99 => assumption 2000+ (tipical on DS3231)
  dt->year = 2000 + bcd2bin(raw[6]);

  return HAL_OK;
}

/* RTC Set */
HAL_StatusTypeDef DS3231_SetDateTime(I2C_HandleTypeDef *hi2c, const DS3231_DateTime *dt)
{
  uint8_t raw[7];

  // seconds
  raw[0] = bin2bcd(dt->seconds) & 0x7F;
  raw[1] = bin2bcd(dt->minutes) & 0x7F;

  // hours in 24h mode
  raw[2] = bin2bcd(dt->hours) & 0x3F;

  raw[3] = bin2bcd(dt->dayOfWeek) & 0x07;
  raw[4] = bin2bcd(dt->day) & 0x3F;

  // month: bit7 = century (0 => 2000..2099)
  raw[5] = bin2bcd(dt->month) & 0x1F;

  // year: DS3231 memorize 0..99
  uint8_t yy = (dt->year >= 2000) ? (uint8_t)(dt->year - 2000) : (uint8_t)(dt->year % 100);
  raw[6] = bin2bcd(yy);

  // Burst write 7 byte starting from 0x00
  return HAL_I2C_Mem_Write(
      hi2c,
      DS3231_ADDR,
      0x00,
      I2C_MEMADD_SIZE_8BIT,
      raw,
      7,
      100
  );
}

HAL_StatusTypeDef DS3231_DumpDecoded(I2C_HandleTypeDef *hi2c)
{
  uint8_t raw[7] = {1,2,3,4,5,6,7};

  HAL_StatusTypeDef st = HAL_I2C_Mem_Read(
      hi2c, DS3231_ADDR, 0x00, I2C_MEMADD_SIZE_8BIT, raw, 7, 100);

  st = HAL_I2C_Mem_Read(
      hi2c, DS3231_ADDR, 6, I2C_MEMADD_SIZE_8BIT, &raw[6], 1, 100);

  if (st != HAL_OK) return st;
  printf("DS3231 RAW: %02X %02X %02X %02X %02X %02X %02X\r\n",
         raw[0], raw[1], raw[2], raw[3], raw[4], raw[5], raw[6]);

  uint8_t sec  = bcd2bin(raw[0] & 0x7F);
  uint8_t min  = bcd2bin(raw[1] & 0x7F);
  uint8_t hour = bcd2bin(raw[2] & 0x3F);
  uint8_t dow  = bcd2bin(raw[3] & 0x07);
  uint8_t dom  = bcd2bin(raw[4] & 0x3F);
  uint8_t mon  = bcd2bin(raw[5] & 0x1F);
  uint8_t yy   = bcd2bin(raw[6]);           // THIS is the year 00..99
  uint16_t year = 2000 + yy;

  printf("Decoded: %04u-%02u-%02u DOW=%u %02u:%02u:%02u\r\n",
         year, mon, dom, dow, hour, min, sec);

  return HAL_OK;
}

static void OLED_ShowTime(void *oled, const DS3231_DateTime *dt)
{
  char line1[16];
  char line2[22];

  // Set date and time
  snprintf(line1, sizeof(line2), "%04u-%02u-%02u", dt->year, dt->month, dt->day);
  snprintf(line2, sizeof(line1), "%02u:%02u:%02u", dt->hours, dt->minutes, dt->seconds);

  // Oled Write
  ssd1306_set_cursor(oled, 0, 30);
  ssd1306_write_string(oled, line1, 2);
  ssd1306_set_cursor(oled, 0, 40);
  ssd1306_write_string(oled, line2, 1);
  ssd1306_update(oled);
}

// Displays temperature on SSD1306 OLED.
void OLED_ShowTemperature(void *oled, float temperature_c)
{
  char line1[20];
  char line2[20];

  // Format strings
  snprintf(line1, sizeof(line1), "TEMPERATURE: %d C", (uint16_t)temperature_c);

  // Write temperature
  ssd1306_set_cursor(oled, 0, 50);
  ssd1306_write_string(oled, line1, 1);

  // Push buffer to display
  ssd1306_update(oled);
}
static uint16_t u16_le(const uint8_t *p) { return (uint16_t)(p[0] | (p[1] << 8)); }
static int16_t  s16_le(const uint8_t *p) { return (int16_t)u16_le(p); }

static HAL_StatusTypeDef bme_read(BME280_Handle *b, uint8_t reg, uint8_t *buf, uint16_t len)
{
  return HAL_I2C_Mem_Read(b->hi2c, b->addr, reg, I2C_MEMADD_SIZE_8BIT, buf, len, 200);
}

static HAL_StatusTypeDef bme_read8(BME280_Handle *b, uint8_t reg, uint8_t *v)
{
  return bme_read(b, reg, v, 1);
}

static HAL_StatusTypeDef bme_write8(BME280_Handle *b, uint8_t reg, uint8_t v)
{
  return HAL_I2C_Mem_Write(b->hi2c, b->addr, reg, I2C_MEMADD_SIZE_8BIT, &v, 1, 100);
}

static HAL_StatusTypeDef bme_wait_nvm(BME280_Handle *b, uint32_t timeout_ms)
{
  uint32_t t0 = HAL_GetTick();
  uint8_t st = 0xFF;

  // Wait until im_update bit is 0
  while (1) {
    if (bme_read8(b, BME280_REG_STATUS, &st) != HAL_OK) return HAL_ERROR;
    if ((st & 0x01) == 0) return HAL_OK;
    if ((HAL_GetTick() - t0) > timeout_ms) return HAL_TIMEOUT;
    HAL_Delay(2);
  }
}

static HAL_StatusTypeDef BME280_ReadCalibration(BME280_Handle *b)
{
  uint8_t calib1[26];
  uint8_t calib2[7];

  // Read calib data block 1: 0x88..0xA1 (26 bytes)
  if (bme_read(b, 0x88, calib1, sizeof(calib1)) != HAL_OK) return HAL_ERROR;

  b->dig_T1 = u16_le(&calib1[0]);
  b->dig_T2 = s16_le(&calib1[2]);
  b->dig_T3 = s16_le(&calib1[4]);

  b->dig_P1 = u16_le(&calib1[6]);
  b->dig_P2 = s16_le(&calib1[8]);
  b->dig_P3 = s16_le(&calib1[10]);
  b->dig_P4 = s16_le(&calib1[12]);
  b->dig_P5 = s16_le(&calib1[14]);
  b->dig_P6 = s16_le(&calib1[16]);
  b->dig_P7 = s16_le(&calib1[18]);
  b->dig_P8 = s16_le(&calib1[20]);
  b->dig_P9 = s16_le(&calib1[22]);

  b->dig_H1 = calib1[25]; // 0xA1

  // Read calib data block 2: 0xE1..0xE7 (7 bytes)
  if (bme_read(b, 0xE1, calib2, sizeof(calib2)) != HAL_OK) return HAL_ERROR;

  b->dig_H2 = s16_le(&calib2[0]);
  b->dig_H3 = calib2[2];

  // H4 and H5 are packed across bytes
  b->dig_H4 = (int16_t)((calib2[3] << 4) | (calib2[4] & 0x0F));
  b->dig_H5 = (int16_t)((calib2[5] << 4) | (calib2[4] >> 4));
  b->dig_H6 = (int8_t)calib2[6];

  return HAL_OK;
}

// Compensation formulas from Bosch datasheet (integer math)
static int32_t BME280_Compensate_T(BME280_Handle *b, int32_t adc_T)
{
  int32_t var1, var2, T;
  var1 = ((((adc_T >> 3) - ((int32_t)b->dig_T1 << 1))) * ((int32_t)b->dig_T2)) >> 11;
  var2 = (((((adc_T >> 4) - ((int32_t)b->dig_T1)) * ((adc_T >> 4) - ((int32_t)b->dig_T1))) >> 12) *
          ((int32_t)b->dig_T3)) >> 14;
  b->t_fine = var1 + var2;
  T = (b->t_fine * 5 + 128) >> 8; // Temperature in 0.01 °C
  return T;
}

static uint32_t BME280_Compensate_P(BME280_Handle *b, int32_t adc_P)
{
  int64_t var1, var2, p;
  var1 = ((int64_t)b->t_fine) - 128000;
  var2 = var1 * var1 * (int64_t)b->dig_P6;
  var2 = var2 + ((var1 * (int64_t)b->dig_P5) << 17);
  var2 = var2 + (((int64_t)b->dig_P4) << 35);
  var1 = ((var1 * var1 * (int64_t)b->dig_P3) >> 8) + ((var1 * (int64_t)b->dig_P2) << 12);
  var1 = (((((int64_t)1) << 47) + var1) * (int64_t)b->dig_P1) >> 33;

  if (var1 == 0) return 0; // Avoid division by zero

  p = 1048576 - adc_P;
  p = (((p << 31) - var2) * 3125) / var1;
  var1 = ((int64_t)b->dig_P9 * (p >> 13) * (p >> 13)) >> 25;
  var2 = ((int64_t)b->dig_P8 * p) >> 19;
  p = ((p + var1 + var2) >> 8) + (((int64_t)b->dig_P7) << 4);

  return (uint32_t)p; // Pressure in Q24.8 (Pa * 256)
}

static uint32_t BME280_Compensate_H(BME280_Handle *b, int32_t adc_H)
{
  int32_t v_x1_u32r;

  v_x1_u32r = (b->t_fine - ((int32_t)76800));
  v_x1_u32r = (((((adc_H << 14) - (((int32_t)b->dig_H4) << 20) - (((int32_t)b->dig_H5) * v_x1_u32r)) +
                 ((int32_t)16384)) >> 15) *
               (((((((v_x1_u32r * ((int32_t)b->dig_H6)) >> 10) *
                    (((v_x1_u32r * ((int32_t)b->dig_H3)) >> 11) + ((int32_t)32768))) >> 10) +
                  ((int32_t)2097152)) * ((int32_t)b->dig_H2) + 8192) >> 14));

  v_x1_u32r = (v_x1_u32r - (((((v_x1_u32r >> 15) * (v_x1_u32r >> 15)) >> 7) * ((int32_t)b->dig_H1)) >> 4));

  if (v_x1_u32r < 0) v_x1_u32r = 0;
  if (v_x1_u32r > 419430400) v_x1_u32r = 419430400;

  return (uint32_t)(v_x1_u32r >> 12); // Humidity in 1024 * %RH
}

HAL_StatusTypeDef BME280_Init(BME280_Handle *b)
{
  uint8_t id = 0xFF;

  // Read chip ID (0x60 for BME280)
  if (bme_read8(b, BME280_REG_ID, &id) != HAL_OK) return HAL_ERROR;
  if (id != 0x60) return HAL_ERROR;

  // Soft reset
  if (bme_write8(b, BME280_REG_RESET, 0xB6) != HAL_OK) return HAL_ERROR;
  HAL_Delay(5);

  // Wait for NVM copy to complete
  if (bme_wait_nvm(b, 100) != HAL_OK) return HAL_ERROR;

  // Read calibration data
  if (BME280_ReadCalibration(b) != HAL_OK) return HAL_ERROR;

  // Humidity oversampling must be set BEFORE ctrl_meas
  // osrs_h = x1
  if (bme_write8(b, BME280_REG_CTRL_H, 0x01) != HAL_OK) return HAL_ERROR;

  // config: standby 1000ms, filter off
  if (bme_write8(b, BME280_REG_CONFIG, 0xA0) != HAL_OK) return HAL_ERROR;

  // ctrl_meas: temp x1, press x1, normal mode
  if (bme_write8(b, BME280_REG_CTRL_M, 0x27) != HAL_OK) return HAL_ERROR;

  return HAL_OK;
}

HAL_StatusTypeDef BME280_ReadData(BME280_Handle *b, BME280_Data *out)
{
  uint8_t buf[8];

  // Read press(3) + temp(3) + hum(2)
  if (bme_read(b, BME280_REG_DATA, buf, sizeof(buf)) != HAL_OK) return HAL_ERROR;

  int32_t adc_P = (int32_t)((buf[0] << 12) | (buf[1] << 4) | (buf[2] >> 4));
  int32_t adc_T = (int32_t)((buf[3] << 12) | (buf[4] << 4) | (buf[5] >> 4));
  int32_t adc_H = (int32_t)((buf[6] << 8) | buf[7]);

  int32_t T_01c = BME280_Compensate_T(b, adc_T);
  uint32_t P_q24_8 = BME280_Compensate_P(b, adc_P);
  uint32_t H_1024 = BME280_Compensate_H(b, adc_H);

  out->temperature_c = (float)T_01c / 100.0f;
  out->pressure_hpa  = ((float)P_q24_8 / 256.0f) / 100.0f; // Pa -> hPa
  out->humidity_rh   = (float)H_1024 / 1024.0f;

  return HAL_OK;
}

static HAL_StatusTypeDef tmp102_read16(I2C_HandleTypeDef *hi2c, uint16_t addr, uint8_t reg, uint16_t *out)
{
  uint8_t buf[2];

  // Read 2 bytes (MSB first)
  HAL_StatusTypeDef st = HAL_I2C_Mem_Read(hi2c, addr, reg, I2C_MEMADD_SIZE_8BIT, buf, 2, 100);
  if (st != HAL_OK) return st;

  *out = (uint16_t)((buf[0] << 8) | buf[1]);
  return HAL_OK;
}

static HAL_StatusTypeDef tmp102_write16(I2C_HandleTypeDef *hi2c, uint16_t addr, uint8_t reg, uint16_t value)
{
  uint8_t buf[2];

  // Write 2 bytes (MSB first)
  buf[0] = (uint8_t)(value >> 8);
  buf[1] = (uint8_t)(value & 0xFF);

  return HAL_I2C_Mem_Write(hi2c, addr, reg, I2C_MEMADD_SIZE_8BIT, buf, 2, 100);
}

// Converts TMP102 temperature register to Celsius.
// TMP102 default is 12-bit resolution: bits [15:4] contain temperature (two's complement), LSB=0.0625°C.
// Some configs enable 13-bit; this conversion still works if you keep the right shift consistent with your config.
static float tmp102_raw_to_celsius(uint16_t raw)
{
  // Temperature is a signed value in the upper bits.
  // For 12-bit mode, the temp is in bits 15..4 (signed), so shift right by 4.
  int16_t signed_temp = (int16_t)raw;
  signed_temp >>= 4;

  // Each LSB is 0.0625°C (1/16)
  return (float)signed_temp * 0.0625f;
}

// Optional init: set defaults you like (continuous conversion, 12-bit).
// If you skip this, TMP102 still works with power-on defaults.
HAL_StatusTypeDef TMP102_Init(I2C_HandleTypeDef *hi2c, uint16_t addr)
{
  // Example config (TMP102):
  // - Continuous conversion (shutdown=0)
  // - 12-bit resolution (R1=0, R0=0)
  // - Active-low alert, comparator mode, default polarity, etc.
  // This value is a safe "mostly default" config: 0x60A0 is common on power-up, but varies by vendor.
  // If you already configured it elsewhere, you can omit this function.
  uint16_t cfg = 0x60A0;
  return tmp102_write16(hi2c, addr, TMP102_REG_CONFIG, cfg);
}

HAL_StatusTypeDef TMP102_ReadTemperatureC(I2C_HandleTypeDef *hi2c, uint16_t addr, float *temp_c)
{
  uint16_t raw;

  HAL_StatusTypeDef st = tmp102_read16(hi2c, addr, TMP102_REG_TEMP, &raw);
  if (st != HAL_OK) return st;

  *temp_c = tmp102_raw_to_celsius(raw);
  return HAL_OK;
}

void I2C_ScanAndPrint(I2C_HandleTypeDef *hi2c)
{
  uint8_t found = 0;

  printf("I2C scan start...\r\n");

  // Valid 7-bit I2C addresses range from 0x03 to 0x77
  for (uint8_t addr7 = 0x03; addr7 <= 0x77; addr7++) {

    // HAL expects 8-bit address (7-bit shifted left by 1)
    if (HAL_I2C_IsDeviceReady(hi2c, (uint16_t)(addr7 << 1), 2, 10) == HAL_OK) {
      printf("  Found device at 0x%02X\r\n", addr7);
      found++;
    }
  }

  if (found == 0) {
    printf("  No I2C devices found\r\n");
  } else {
    printf("I2C scan done, %u device(s) found\r\n", found);
  }
}

// LIN classic SYNC field is always 0x55
#define LIN_SYNC 0x55

// -----------------------------------------------------------------------------
// Build LIN Protected Identifier (PID)
// ID is 6-bit (0..63), parity bits P0/P1 are added
// -----------------------------------------------------------------------------
static uint8_t LIN_MakePID(uint8_t id6)
{
    id6 &= 0x3F;

    uint8_t b0 = (id6 >> 0) & 1;
    uint8_t b1 = (id6 >> 1) & 1;
    uint8_t b2 = (id6 >> 2) & 1;
    uint8_t b3 = (id6 >> 3) & 1;
    uint8_t b4 = (id6 >> 4) & 1;
    uint8_t b5 = (id6 >> 5) & 1;

    // LIN parity definition:
    // P0 = b0 ⊕ b1 ⊕ b2 ⊕ b4
    // P1 = NOT(b1 ⊕ b3 ⊕ b4 ⊕ b5)
    uint8_t p0 = (uint8_t)(b0 ^ b1 ^ b2 ^ b4) & 1;
    uint8_t p1 = (uint8_t)(~(b1 ^ b3 ^ b4 ^ b5)) & 1;

    // PID = ID + parity bits
    return (uint8_t)(id6 | (p0 << 6) | (p1 << 7));
}

// -----------------------------------------------------------------------------
// LIN checksum mode
// Classic: checksum over DATA only (LIN 1.x)
// Enhanced: checksum over PID + DATA (LIN 2.x)
// -----------------------------------------------------------------------------
typedef enum {
    LIN_CHECKSUM_CLASSIC = 0,
    LIN_CHECKSUM_ENHANCED = 1
} LinChecksumMode;

// -----------------------------------------------------------------------------
// Compute LIN checksum
// -----------------------------------------------------------------------------
static uint8_t LIN_Checksum(const uint8_t *data,
                            uint8_t len,
                            uint8_t pid,
                            LinChecksumMode mode)
{
    uint16_t sum = 0;

    // Enhanced checksum includes PID
    if (mode == LIN_CHECKSUM_ENHANCED) {
        sum += pid;
    }

    // Add all data bytes with carry-around
    for (uint8_t i = 0; i < len; i++) {
        sum += data[i];
        if (sum > 0xFF) {
            sum = (sum & 0xFF) + 1;
        }
    }

    // Final checksum is one's complement
    return (uint8_t)(~sum);
}

// -----------------------------------------------------------------------------
// Send a complete LIN frame:
// BREAK + SYNC + PID + DATA + CHECKSUM
// -----------------------------------------------------------------------------
HAL_StatusTypeDef LIN_SendFrame(UART_HandleTypeDef *huart,
                               uint8_t id6,
                               const uint8_t *data,
                               uint8_t len,
                               LinChecksumMode checksumMode,
                               uint32_t timeoutMs)
{
    if (len > 8) {
        return HAL_ERROR;
    }

    uint8_t pid = LIN_MakePID(id6);

    // 1) Send LIN BREAK field
    // This function is available on most STM32 HAL implementations
    if (HAL_LIN_SendBreak(huart) != HAL_OK) {
        return HAL_ERROR;
    }

    // 2) Send SYNC byte (0x55)
    uint8_t sync = LIN_SYNC;
    if (HAL_UART_Transmit(huart, &sync, 1, timeoutMs) != HAL_OK) {
        return HAL_ERROR;
    }

    // 3) Send Protected Identifier (PID)
    if (HAL_UART_Transmit(huart, &pid, 1, timeoutMs) != HAL_OK) {
        return HAL_ERROR;
    }

    // 4) Send data bytes (1..8)
    if (len > 0) {
        if (HAL_UART_Transmit(huart, (uint8_t *)data, len, timeoutMs) != HAL_OK) {
            return HAL_ERROR;
        }
    }

    // 5) Send checksum
    uint8_t checksum = LIN_Checksum(data, len, pid, checksumMode);
    if (HAL_UART_Transmit(huart, &checksum, 1, timeoutMs) != HAL_OK) {
        return HAL_ERROR;
    }

    return HAL_OK;
}

/* TASKS */

TASK(CAN_Task)
{
#ifdef USB_LOGGING
	printf("Task CAN_Task running...\r\n");
#endif

	static uint32_t counter = 0;
	static CAN_RxHeaderTypeDef rxHeader;
	static uint8_t rxData[8];

	uint8_t CanMsg_1[8] = {0, 0, 0, 0, 0, 0, 0xAA, 0xBB};
	uint8_t CanMsg_2[8] = {0, 0, 0, 0, 0, 0, 0xCA, 0xFE};
	uint8_t CanMsg_3[8] = {0, 0, 0, 0, 0, 0, 0, 0};
	uint8_t CanMsg_4[8] = {0, 0, 0, 0, 0, 0, 0, 0};
	uint8_t CanMsg_5[8] = {0, 0, 0, 0, 0, 0, 0, 0};
	uint8_t CanMsg_6[8] = {0, 0, 0, 0, 0, 0, 0, 0};


	/* Can msg 1 */
	counter++;
	CanMsg_1[0] = counter >> 24;
	CanMsg_1[1] = counter >> 16;
	CanMsg_1[2] = counter >> 8;
	CanMsg_1[3] = counter;

	CanMsg_2[0] = adc_in1 >> 8;
	CanMsg_2[1] = adc_in1;

	memcpy(CanMsg_3, &now, 8);
	memcpy(CanMsg_4, &d.temperature_c, 4);
	memcpy(CanMsg_5, &d.pressure_hpa, 4);
	memcpy(CanMsg_6, &d.humidity_rh, 4);

	CAN_SendMessage(0x123, 8, CanMsg_1);
	CAN_SendMessage(0x456, 8, CanMsg_2);
	CAN_SendMessage(0x550, 8, CanMsg_3);
	CAN_SendMessage(0x600, 8, CanMsg_4);
	CAN_SendMessage(0x601, 8, CanMsg_5);
	CAN_SendMessage(0x602, 8, CanMsg_6);

	/* CAN Rx */
	if (HAL_CAN_GetRxFifoFillLevel(&hcan, CAN_RX_FIFO0) > 0)
	{
	    if (HAL_CAN_GetRxMessage(&hcan, CAN_RX_FIFO0, &rxHeader, rxData) == HAL_OK)
	    {
	        // rxHeader.StdId  -> ID (if standard)
	        // rxHeader.ExtId  -> ID (if extended)
	        // rxHeader.DLC    -> DLC
	        // rxData[]        -> payload
	    	if (rxHeader.StdId == 0x100)
	    	{
	    		if ((rxData[0] == 0) || (rxData[0] == 1))
	    			HAL_GPIO_WritePin(LED_1_GPIO_Port, LED_1_Pin, rxData[0]);
	    		else
	    			HAL_GPIO_TogglePin(LED_1_GPIO_Port, LED_1_Pin);
		    	HAL_GPIO_WritePin(LED_2_GPIO_Port, LED_2_Pin, rxData[1]);
		    	HAL_GPIO_WritePin(LED_3_GPIO_Port, LED_3_Pin, rxData[2]);
	    	}
	    }
	}


	/* Task Termination */
	Os_TerminateTask();
}

TASK(RS485_Task)
{
#ifdef USB_LOGGING
	printf("Task RS485_Task running...\r\n");
#endif

	/* Enable write */
	HAL_GPIO_WritePin(RS485_DE_GPIO_Port, RS485_DE_Pin, 1);
	/* Send String */
	RS485_SendString("RS485 Hello World!!!\r\n");
	/* Disable write */
	HAL_GPIO_WritePin(RS485_DE_GPIO_Port, RS485_DE_Pin, 0);

	/* Task Termination */
	Os_TerminateTask();
}

TASK(LED_Task)
{
#ifdef USB_LOGGING
	printf("Task LED_Task running...\r\n");
#endif

	/* Led 1 toggle */
	HAL_GPIO_TogglePin(LED_0_GPIO_Port, LED_0_Pin);

	/* Task Termination */
	Os_TerminateTask();
}

TASK(Readings_Task)
{
#ifdef USB_LOGGING
	printf("Task Readings_Task running...\r\n");
#endif
	static bool FirstExecution = false;

	if (FirstExecution == false)
	{
		FirstExecution = true;

		I2C_ScanAndPrint(&hi2c1);

		if (BME280_Init(&bme) != HAL_OK)
		{
			printf("BME280 init error...");
		}

		if (TMP102_Init(&hi2c1, TMP102_ADDR_0x48) != HAL_OK)
		{
			printf("TMP102 init error...");
		}

#ifdef RTC_SET
		DS3231_SetDateTime(&hi2c1, &set);
#endif
	}

	ADC_ChannelConfTypeDef sConfig = {0};

	/* IN1 */
	sConfig.Channel = ADC_CHANNEL_1;          // IN1 = PA1
	sConfig.Rank = ADC_REGULAR_RANK_1;
	sConfig.SamplingTime = ADC_SAMPLETIME_28CYCLES_5;
	HAL_ADC_ConfigChannel(&hadc1, &sConfig);
	HAL_ADC_Start(&hadc1);
	HAL_ADC_PollForConversion(&hadc1, HAL_MAX_DELAY);
	adc_in1 = HAL_ADC_GetValue(&hadc1);
	HAL_ADC_Stop(&hadc1);

	/* Read external RTC */
	DS3231_ReadDateTime(&hi2c1, &now);

	/* Read BMP280 data */
	BME280_ReadData(&bme, &d);

	/* Read temperature */
	if (TMP102_ReadTemperatureC(&hi2c1, TMP102_ADDR_0x48, &temp) == HAL_OK)
	{
	  OLED_ShowTemperature(&oled, temp);
	};

	/* Task Termination */
	Os_TerminateTask();
}

TASK(OLED_Task)
{
#ifdef USB_LOGGING
	printf("Task OLED_Task running...\r\n");
#endif

	/* Write data on OLED */
	OLED_ShowTime(&oled, &now);

	/* Task Termination */
	Os_TerminateTask();
}

TASK(Serial_Task)
{
#ifdef USB_LOGGING
	printf("Task OLED_Task running...\r\n");
#endif

	static uint8_t lin_cnt = 0;
	// Log date/time on serial
	printf("%04u-%02u-%02u %02u:%02u:%02u\r\n", now.year, now.month, now.day, now.hours, now.minutes, now.seconds);

    uint8_t payload[8] = { 0x00, 0x22, 0x33, 0x44, 0x55, 0x66, 0x77, 0x88 };

    lin_cnt++;
    payload[0] = lin_cnt;


    // Send LIN frame with:
    // ID = 0x12 (6-bit)
    // Data length = 4
    // Enhanced checksum (LIN 2.x)
    LIN_SendFrame(&huart2,
                        LIN_FRAME_ID,
                        payload,
                        8,
                        LIN_CHECKSUM_ENHANCED,
                        10);

	/* Task Termination */
	Os_TerminateTask();
}
